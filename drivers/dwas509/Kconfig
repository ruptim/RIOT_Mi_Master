## drivers/dwas509/Kconfig
```kconfig
# Copyright (c) 2025 HAW
#
# This file is subject to the terms and conditions of the GNU Lesser
# General Public License v2.1. See the file LICENSE in the top level
# directory for more details.

config MODULE_DWAS509
    bool "dwas509"
    depends on TEST_KCONFIG
    select MODULE_PERIPH_ADC
```

## drivers/reed_sensor_driver/Kconfig
```kconfig
# Copyright (c) 2024 HAW Hamburg
#
# This file is subject to the terms and conditions of the GNU Lesser
# General Public License v2.1. See the file LICENSE in the top level
# directory for more details.

config MODULE_REED_SENSOR_DRIVER
    bool "Reed Sensor"
    depends on TEST_KCONFIG
```
